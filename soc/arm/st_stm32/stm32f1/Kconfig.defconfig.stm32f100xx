## soc/arm/st_stm32/stm32f1/Kconfig.defconfig.stm32f100xx
```kconfig
# ST Microelectronics STM32F100XX MCU

# Copyright (c) 2020, Jonas Eriksson, Up to Code AB
# SPDX-License-Identifier: Apache-2.0

config SOC
	default "stm32f100xb" if SOC_STM32F100XB
	default "stm32f100xe" if SOC_STM32F100XE

config NUM_IRQS
	default 61 if SOC_STM32F100XB
	default 61 if SOC_STM32F100XE
```

## soc/arm/st_stm32/stm32f1/Kconfig.defconfig.stm32f101xx
```kconfig
# ST Microelectronics STM32F100XX MCU

# Copyright (c) 2020, Jonas Eriksson, Up to Code AB
# SPDX-License-Identifier: Apache-2.0

config SOC
	default "stm32f101x6" if SOC_STM32F101X6
	default "stm32f101xb" if SOC_STM32F101XB
	default "stm32f101xe" if SOC_STM32F101XE
	default "stm32f101xg" if SOC_STM32F101XG

config NUM_IRQS
	default 60 if SOC_STM32F101X6
	default 60 if SOC_STM32F101XB
	default 60 if SOC_STM32F101XE
	default 60 if SOC_STM32F101XG
```

## soc/arm/st_stm32/stm32f1/Kconfig.defconfig.stm32f102xx
```kconfig
# ST Microelectronics STM32F100XX MCU

# Copyright (c) 2020, Jonas Eriksson, Up to Code AB
# SPDX-License-Identifier: Apache-2.0

config SOC
	default "stm32f100x6" if SOC_STM32F100X6
	default "stm32f100xb" if SOC_STM32F100XB

config NUM_IRQS
	default 60 if SOC_STM32F100X6
	default 60 if SOC_STM32F100XB
```

## soc/arm/st_stm32/stm32f1/Kconfig.defconfig.stm32f103xx
```kconfig
# ST Microelectronics STM32F103XX MCU

# Copyright (c) 2017, embedjournal.com
# SPDX-License-Identifier: Apache-2.0

config SOC
	default "stm32f103x6" if SOC_STM32F103X6
	default "stm32f103xb" if SOC_STM32F103XB
	default "stm32f103xe" if SOC_STM32F103XE
	default "stm32f103xg" if SOC_STM32F103XG

config NUM_IRQS
	default 60 if SOC_STM32F103X6
	default 60 if SOC_STM32F103XB
	default 60 if SOC_STM32F103XE
	default 60 if SOC_STM32F103XG
```

## soc/arm/st_stm32/stm32f1/Kconfig.defconfig.stm32f105xc
```kconfig
# ST Microelectronics STM32F105XC MCU

# Copyright (c) 2019 Argentum Systems Ltd.
# SPDX-License-Identifier: Apache-2.0

if SOC_STM32F105XC

config SOC
	default "stm32f105xc"

config NUM_IRQS
	default 68

endif # SOC_STM32F105XC
```

## soc/arm/st_stm32/stm32f1/Kconfig.soc
```kconfig
# ST Microelectronics STM32F1 MCU line

# Copyright (c) 2016 Open-RnD Sp. z o.o.
# Copyright (c) RnDity Sp. z o.o.
# SPDX-License-Identifier: Apache-2.0

choice
	prompt "STM32F1x MCU Selection"
	depends on SOC_SERIES_STM32F1X

config SOC_STM32F100XB
	bool "STM32F100x4/6/8/B"

config SOC_STM32F100XE
	bool "STM32F100xC/D/E"

config SOC_STM32F101X6
	bool "STM32F101x4/6"
	select SOC_STM32F10X_DENSITY_DEVICE

config SOC_STM32F101XB
	bool "STM32F101x8/B"
	select SOC_STM32F10X_DENSITY_DEVICE

config SOC_STM32F101XE
	bool "STM32F101xC/D/E"
	select SOC_STM32F10X_DENSITY_DEVICE

config SOC_STM32F101XG
	bool "STM32F101xF/G"
	select SOC_STM32F10X_DENSITY_DEVICE

config SOC_STM32F102X6
	bool "STM32F102x4/6"
	select SOC_STM32F10X_DENSITY_DEVICE

config SOC_STM32F102XB
	bool "STM32F102x8/B"
	select SOC_STM32F10X_DENSITY_DEVICE

config SOC_STM32F103X6
	bool "STM32F103x4/6"
	select SOC_STM32F10X_DENSITY_DEVICE

config SOC_STM32F103XB
	bool "STM32F103x8/B"
	select SOC_STM32F10X_DENSITY_DEVICE

config SOC_STM32F103XE
	bool "STM32F103xC/D/E"
	select SOC_STM32F10X_DENSITY_DEVICE

config SOC_STM32F103XG
	bool "STM32F103xF/G"
	select SOC_STM32F10X_DENSITY_DEVICE

config SOC_STM32F105XC
	bool "STM32F105x8/B/C"
	select SOC_STM32F10X_CONNECTIVITY_LINE_DEVICE

config SOC_STM32F107XC
	bool "STM32F107xB/C"
	select SOC_STM32F10X_CONNECTIVITY_LINE_DEVICE

endchoice

config SOC_STM32F10X_DENSITY_DEVICE
	bool
	help
	  STM32F101xx, STM32F102xx, STM32F103xx:
	  * Low density Value line devices
	  * Medium density Value line devices
	  * High density Value line devices
	  * XL-density devices Value line devices

config SOC_STM32F10X_CONNECTIVITY_LINE_DEVICE
	bool
	help
	  Connectivity line devices are STM32F105xx and STM32F107xx
	  microcontrollers.  They are intended for applications where
	  connectivity and real-time performances are required such as
	  industrial control, control panels for security applications, UPS or
	  home audio.  For STM32F107xx also the Ethernet MAC is available.
```
